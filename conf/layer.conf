## conf/layer.conf
```bitbake
# We have a conf and classes directory, add to BBPATH
BBPATH .= ":${LAYERDIR}"

# We have recipes-* directories, add to BBFILES
BBFILES += "${LAYERDIR}/recipes-*/*/*.bb \
            ${LAYERDIR}/recipes-*/*/*.bbappend"

BBFILE_COLLECTIONS += "essa-mx8mm"
BBFILE_PATTERN_essa-mx8mm = "^${LAYERDIR}/"
BBFILE_PRIORITY_essa-mx8mm = "13"

# Additional HAB information is provided by printing HAB FIT information
IMXBOOT_TARGETS_append = " print_fit_hab"

# userspace packages for dm-crypt
# Don't use += (creates weird issues) and use _append =
IMAGE_INSTALL_append = " libgcc"
IMAGE_INSTALL_append = " udev"
IMAGE_INSTALL_append = " lvm2"
IMAGE_INSTALL_append = " e2fsprogs-mke2fs"
IMAGE_INSTALL_append = " coreutils"
IMAGE_INSTALL_append = " keyutils"
IMAGE_INSTALL_append = " util-linux"
IMAGE_INSTALL_append = " cryptodev-module"
IMAGE_INSTALL_append = " cryptsetup"
# Adding init script for cryptsetup
IMAGE_INSTALL_append = " sys-setup"
IMAGE_INSTALL_append = " caam-keygen"
# Adding ZModem utility
IMAGE_INSTALL_append = " lrzsz"

# Changing the WKS file to add DM partition
WKS_FILE = "imx-bootpart-dm.wks.in"

LAYERDEPENDS_essa-mx8mm = "core"
LAYERSERIES_COMPAT_essa-mx8mm = "hardknott"
```
